VERSION ""

NS_ :

BS_:

BU_:

BO_ 386 Joystick: 4 Vector__XXX
	SG_ RightLeft : 0|16@1- (1,0) [-1100|1100] "XPos" Vector__XXX
	SG_ FrontRear : 16|16@1- (1,0) [-1100|1000] "YPos" Vector__XXX

BO_ 385 Speed_L: 7 Vector__XXX
	SG_ Speed_Left : 0|16@1- (0.01144,0) [-3.5|10] "km/h" Vector__XXX

BO_ 641 Speed_R: 7 Vector__XXX
	SG_ Speed_Right : 0|16@1- (0.01144,0) [-3.5|10] "km/h" Vector__XXX

CM_ BO_ 386 "Main Joystick";
CM_ BO_ 385 "Speed_Left";
CM_ BO_ 641 "Speed_Right";
